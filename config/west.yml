## config/west.yml
```yaml
manifest:
  remotes:
    - name: zmkfirmware
      url-base: https://github.com/zmkfirmware
      # Additional modules containing boards/shields/custom code can be listed here as well.
      # See:
      # - https://zmk.dev/docs/features/modules
      # - https://docs.zephyrproject.org/3.5.0/develop/west/manifest.html#projects
    - name: gpeye
      url-base: https://github.com/GPeye
    - name: dsifry #new entry
      url-base: https://github.com/dsifry #new entry
  projects:
    - name: eyelash_sofle
      url: https://github.com/tonycsoka/zmk-sofle
      revision: main
    - name: nice-view-mod #new entry
      remote: dsifry #new entry
      revision: main #new entry
    - name: zmk
      remote: zmkfirmware
      revision: main
      import: app/west.yml
  self:
    path: config
```
